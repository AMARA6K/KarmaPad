## config/boards/shields/karmapad/Kconfig.defconfig
```kconfig
if SHIELD_KARMAPAD

config ZMK_KEYBOARD_NAME
    default "KarmaPad"

config ZMK_DISPLAY
    default y

config I2C
    default y

config SSD1306
    default y

config ZMK_BATTERY_REPORTING
    default y

config ZMK_SLEEP
    default y

config ZMK_IDLE_SLEEP_TIMEOUT
    default 900000

config EC11
    default y

endif
```

## west.yml
```yaml
# KarmaPad build manifest
# "If humans made it, I can do it too."
manifest:
  remotes:
    - name: zmkfirmware
      url-base: https://github.com/zmkfirmware
  projects:
    - name: zmk
      remote: zmkfirmware
      revision: main
      import: app/west.yml
  self:
    path: config
```
